AUTOSAR XML (schema 3.1.1)
package /p
  module config configuration: definition=Os, implementation-config-variant=VARIANT-PRE-COMPILE
    container (OsAlarm): linker-symbol-value=ttt
package /AUTOSAR
  module definition Os
    container OsAlarm
      string OsConstName
