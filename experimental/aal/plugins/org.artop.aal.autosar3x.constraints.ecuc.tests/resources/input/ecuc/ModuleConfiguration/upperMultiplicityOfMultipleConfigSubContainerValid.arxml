AUTOSAR XML (schema 3.1.4)
package /p
  module config configuration: definition=Os, implementation-config-variant=VARIANT-POST-BUILD
    container1 (OsAlarm)
    container2 (OsAlarm)
package /AUTOSAR
  module definition Os: variants post-build
    container OsAlarm: multiple-configuration-container=true
