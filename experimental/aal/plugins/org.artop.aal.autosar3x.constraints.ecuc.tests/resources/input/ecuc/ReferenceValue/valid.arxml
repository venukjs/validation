AUTOSAR XML (schema 3.1.1)
package /p
  module config configuration: definition=Osss, implementation-config-variant=VARIANT-PRE-COMPILE
    noDefinition (MyPdu)
    container (OsAlarmmm): DestPduRef=noDefinition
package /AUTOSAR
  module definition Osss
    container MyPdu [0..*]
    container OsAlarmmm
      reference DestPduRef: destination=MyPdu
