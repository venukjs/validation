AUTOSAR XML (schema 3.1.4)
package /OS_Package1
  module config OS_ModuleConfiguration: definition=Os, implementation-config-variant=VARIANT-PRE-COMPILE
    OS_Container (ParamConfContainerDef)
      3 x SubContainerDef:
        OS_SubContainer{1..3}
package /AUTOSAR
  module definition Os
    container ParamConfContainerDef
      container SubContainerDef [0..2]: multiple-configuration-container=true
