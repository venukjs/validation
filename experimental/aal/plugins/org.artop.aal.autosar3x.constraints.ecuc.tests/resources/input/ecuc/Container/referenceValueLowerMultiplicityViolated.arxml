AUTOSAR XML (schema 3.1.1)
package /p
  module config configuration: definition=Osss, implementation-config-variant=VARIANT-PRE-COMPILE
    container (OsAlarmmm): DestPduRef=container
package /AUTOSAR
  module definition Osss
    container OsAlarmmm
      reference DestPduRef [2..3]: destination=MyPdu
