AUTOSAR XML (schema 3.1.1)
package /p
  module config configuration: definition=Os, implementation-config-variant=VARIANT-PRE-COMPILE
    container (OsAlarm): BooleanParameter=true, BooleanParameter=true
package /AUTOSAR
  module definition Os
    container OsAlarm
      boolean BooleanParameter [0..1]: default-value=false
