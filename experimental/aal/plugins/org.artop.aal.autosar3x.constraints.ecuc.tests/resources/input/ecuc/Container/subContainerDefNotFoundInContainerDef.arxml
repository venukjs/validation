AUTOSAR XML (schema 3.1.1)
package /OS_Package1
  module config OS_ModuleConfiguration: definition=Os, implementation-config-variant=VARIANT-PRE-COMPILE
    OS_ChoiceContainer (ChoiceContainerDef)
      OS_Choice (Alternative1)
    OS_Container (ParamConfContainerDef_2)
      OS_SubContainer (SubContainerDef)
package /AUTOSAR
  module definition Os
    choice container ChoiceContainerDef
      container Alternative1
      container Alternative2
    container ParamConfContainerDef
      container SubContainerDef
    container ParamConfContainerDef_2
      container SubContainerDef_2
