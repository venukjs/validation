AUTOSAR XML (schema 3.1.1)
package /p
  module config configuration: definition=Os, implementation-config-variant=VARIANT-PRE-COMPILE
    container (OsAlarm): BooleanParameter=true
package /AUTOSAR
  module definition Os
    container OsAlarm
      boolean BooleanParameter [2..3]: default-value=false
