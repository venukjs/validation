AUTOSAR XML (schema 3.1.1)
package /p
  module config configuration: definition=Os, implementation-config-variant=VARIANT-PRE-COMPILE
    container (OsAlarm): integer-value=7
package /AUTOSAR
  module definition Os
    container OsAlarm
      integer OsAppErrorHook
