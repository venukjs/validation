AUTOSAR XML (schema 4.0)
package /p
  module config configuration: definition=Os, implementation-config-variant=VARIANT-PRE-COMPILE
    container (OsAlarm): CanTpAddressingMode=CANTP_STANDARD
package /AUTOSAR
  module definition Os
    container OsAlarm
      enumeration CanTpAddressingMode: {CANTP_EXTENDED, CANTP_STANDARD}
