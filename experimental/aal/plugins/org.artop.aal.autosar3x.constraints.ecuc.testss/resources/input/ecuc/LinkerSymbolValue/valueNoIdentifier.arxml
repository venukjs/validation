AUTOSAR XML (schema 3.1.4)
package /p
  module config configuration: definition=Os, implementation-config-variant=VARIANT-PRE-COMPILE
    container (OsAlarm): OsConstName=1
package /AUTOSAR
  module definition Os
    container OsAlarm
      linker symbol def OsConstName
      parameters OsConstName
