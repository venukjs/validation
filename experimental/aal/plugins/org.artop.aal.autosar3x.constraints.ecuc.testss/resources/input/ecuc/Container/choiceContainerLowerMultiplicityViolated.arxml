AUTOSAR XML (schema 3.1.1)
package /OS_Package1
  module config OS_ModuleConfiguration: definition=Os, implementation-config-variant=VARIANT-PRE-COMPILE
    OS_Container (ParamConfContainerDef)
      OS_ChoiceContainer1 (ChoiceContainerDef)
        OS_Choice1 (Alternative1)
package /AUTOSAR
  module definition Os
    container ParamConfContainerDef
      choice container ChoiceContainerDef [2..*]
        container Alternative1 [0..1]
        container Alternative2 [0..1]
