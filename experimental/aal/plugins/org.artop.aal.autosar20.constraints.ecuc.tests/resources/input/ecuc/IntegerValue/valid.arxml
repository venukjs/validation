AUTOSAR XML
package /p
  module config configuration: definition=Os, implementation-config-variant=VARIANT-PRE-COMPILE
    container (OsAlarm): OsAppErrorHook=7
package /AUTOSAR
  module definition Os
    container OsAlarm
      integer OsAppErrorHook: 0..667
