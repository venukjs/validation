AUTOSAR XML (schema 2-1-5)
package /ARRoot
  module definition ModuleDef
    container Container
      float FloatDef: ..5.0, default-value=10.0
