AUTOSAR XML (schema 2.1.2)
package /p
  module config configuration: definition=Os, implementation-config-variant=VARIANT-PRE-COMPILE
    container (OsAlarm): OsAppErrorFloat=13.666
package /AUTOSAR
  module definition Os
    container OsAlarm
      float OsAppErrorFloat: 0..0
