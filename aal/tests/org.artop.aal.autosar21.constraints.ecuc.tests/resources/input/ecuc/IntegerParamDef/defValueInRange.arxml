AUTOSAR XML (schema 2-1-5)
package /ARRoot
  module definition ModuleDef
    container Container
      integer IntegerDef: 10..15, default-value=12
