AUTOSAR XML (schema 2-1-5)
package /ARRoot
  module definition ModuleDef
    container Container
      integer IntegerDef: default-value=5
