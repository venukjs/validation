AUTOSAR XML (schema 2-1-5)
package /TEST
  module definition ModuleDef
    container Linkers
      linker symbol def LinkerSymbolDef: default-value=default
