AUTOSAR XML (schema 2-1-5)
package /TEST
  module definition ModuleDef
    container Linkers
      linker symbol def Linker0: default-value=9//
