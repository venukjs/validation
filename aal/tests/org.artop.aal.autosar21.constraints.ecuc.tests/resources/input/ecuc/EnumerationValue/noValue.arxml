AUTOSAR XML (schema 2.1.2)
ar-package:
  module config configuration: definition=Os, implementation-config-variant=VARIANT-PRE-COMPILE
    container (OsAlarm): CanTpAddressingMode=(unset)
package /AUTOSAR
  module definition Os
    container OsAlarm
      enumeration CanTpAddressingMode: {CANTP_EXTENDED, CANTP_STANDARD}
