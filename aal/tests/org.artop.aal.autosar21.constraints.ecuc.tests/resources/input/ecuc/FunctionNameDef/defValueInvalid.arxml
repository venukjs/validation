AUTOSAR XML (schema 2-1-5)
package /TEST
  module definition ModuleDef
    container Functions
      function name Function0: default-value=9//
