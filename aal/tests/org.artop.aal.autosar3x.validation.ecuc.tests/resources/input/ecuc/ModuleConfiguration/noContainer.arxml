AUTOSAR XML (schema 3.1.1)
package /p
  module config proxyDefiniton: implementation-config-variant=VARIANT-POST-BUILD, definition=Os
package /AUTOSAR
  module definition Os: variants post-build
    container OsAlarm
      boolean BooleanParameter: default-value=false
