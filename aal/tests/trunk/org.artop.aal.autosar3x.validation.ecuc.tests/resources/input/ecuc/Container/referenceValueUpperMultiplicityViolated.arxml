AUTOSAR XML (schema 3.1.1)
package /p
  module config configuration: definition=Osss, implementation-config-variant=VARIANT-PRE-COMPILE
    container (OsAlarmmm): DestPduRef=container, DestPduRef=container
package /AUTOSAR
  module definition Osss
    container OsAlarmmm
      reference DestPduRef [0..1]: destination=MyPdu
