AUTOSAR XML (schema 3.1.1)
package /OS_Package
  ecu configuration OS_EcuConfiguration
  module config OS_ModuleConfiguration: definition=Os
package /AUTOSAR
  module definition Os [0..1]
