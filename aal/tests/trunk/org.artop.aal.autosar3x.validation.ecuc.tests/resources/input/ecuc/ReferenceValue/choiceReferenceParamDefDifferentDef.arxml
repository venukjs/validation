AUTOSAR XML (schema 3.1.1)
package /AUTOSAR
  module definition Os
    container OsApplication
      choice reference OsAppScheduleTableRef: destination=[OsScheduleTable, OsScheduleTable_1, OsScheduleTable_2]
    container OsScheduleTable
    container OsScheduleTable_1
    container OsScheduleTable_2
package /OS_Package
  module config OS_ModuleConfiguration: definition=Os, implementation-config-variant=VARIANT-PRE-COMPILE
    OS_OsApplication (OsApplication): OsAppScheduleTableRef=OS_OsScheduleTable
    OS_OsScheduleTable (unresolvableReference)
