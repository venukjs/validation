AUTOSAR XML (schema 3.1.1)
package /p
  module config proxyDefiniton: implementation-config-variant=VARIANT-POST-BUILD, definition=Os
    container ()
package /AUTOSAR
  module definition Os: variants post-build
