AUTOSAR XML (schema 3-1-1)
package /TEST
  module definition ModuleDef
    container Linkers
      linker symbol def Linker0: default-value=9//
