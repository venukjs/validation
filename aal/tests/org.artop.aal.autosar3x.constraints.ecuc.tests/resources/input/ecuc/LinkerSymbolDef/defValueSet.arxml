AUTOSAR XML (schema 3-1-1)
package /TEST
  module definition ModuleDef
    container Linkers
      linker symbol def LinkerSymbolDef: default-value=default
