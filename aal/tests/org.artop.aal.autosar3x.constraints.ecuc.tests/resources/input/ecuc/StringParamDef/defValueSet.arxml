AUTOSAR XML (schema 3-1-1)
package /TEST
  module definition ModuleDef
    container Strings
      string String0 [0..1]: default-value=default
