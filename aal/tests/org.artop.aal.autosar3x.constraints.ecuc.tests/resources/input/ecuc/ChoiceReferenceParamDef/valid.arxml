AUTOSAR XML (schema 3.1.1)
package /AUTOSAR
  module definition Os
    container Alternative1
    container Alternative2
    container ParamConfContainerDef1
      choice reference OsAppScheduleTableRef: destination=[Alternative1, Alternative2]
