AUTOSAR XML (schema 3.1.1)
package /OS_Package
  ecu configuration OS_EcuConfiguration: module=[OS_ModuleConfiguration1, OS_ModuleConfiguration2]
  module config OS_ModuleConfiguration1: definition=Os
  module config OS_ModuleConfiguration2: definition=Os
package /AUTOSAR
  module definition Os [0..1]
