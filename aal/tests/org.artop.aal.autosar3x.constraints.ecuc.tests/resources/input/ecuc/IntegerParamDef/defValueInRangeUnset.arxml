AUTOSAR XML (schema 3-2-1)
package /ARRoot
  module definition ModuleDef
    container Container
      integer IntegerDef: default-value=5
