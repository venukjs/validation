AUTOSAR XML (schema 3-2-1)
package /ARRoot
  module definition ModuleDef
    container Container
      integer IntegerDef: 10..15, default-value=12
