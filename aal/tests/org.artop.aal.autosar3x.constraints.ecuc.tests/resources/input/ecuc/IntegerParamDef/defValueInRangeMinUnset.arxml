AUTOSAR XML (schema 3-2-1)
package /ARRoot
  module definition ModuleDef
    container Container
      integer IntegerDef: ..5, default-value=-1
