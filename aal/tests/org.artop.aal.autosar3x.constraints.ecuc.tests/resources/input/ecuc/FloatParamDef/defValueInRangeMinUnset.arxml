AUTOSAR XML (schema 3-2-1)
package /ARRoot
  module definition ModuleDef
    container Container
      float FloatDef: ..5.0, default-value=-1.0
