AUTOSAR XML (schema 3-1-5)
package /ARRoot
  module definition ModuleDef
    container Container
      float FloatDef: default-value=5.0
