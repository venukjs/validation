AUTOSAR XML (schema 3.1.1)
package /OS_Package1
  composition type OS_Composition
    component OS_ComponentPrototype: type=OS_ApplicationSoftwareComponentType
package /OS_Package2
  application software component type OS_ApplicationSoftwareComponentType
    provide port OS_PPortPrototype
package /OS_Package3
  module config OS_ModuleConfiguration: definition=OS_ModuleDefinition, implementation-config-variant=VARIANT-PRE-COMPILE
    OS_Container (OS_ParamConfContainerDef): OS_InstanceReferenceParamDef={context=/OS_Package1/OS_Composition/OS_ComponentPrototype, value=OS_PPortPrototype}
package /OS_Package4
  module definition OS_ModuleDefinition
    container OS_ParamConfContainerDef
      instance reference OS_InstanceReferenceParamDef: destination-context=ComponentPrototype, destination-type=PPortPrototype
