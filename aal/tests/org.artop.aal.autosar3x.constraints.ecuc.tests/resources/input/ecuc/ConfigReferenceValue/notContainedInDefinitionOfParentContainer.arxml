AUTOSAR XML (schema 3.1.2)
package /AUTOSAR
  module definition Os
    container OsApplication
      reference OsAppScheduleTableRef: destination=OsScheduleTable
    container OsApplication2
      reference OsAppScheduleTableRef2: destination=OsScheduleTable
    container OsScheduleTable
package /OS_Package
  module config OS_ModuleConfiguration: definition=Os, implementation-config-variant=VARIANT-PRE-COMPILE
    OS_OsApplication (OsApplication): OsAppScheduleTableRef2=OS_OsScheduleTable
    OS_OsScheduleTable (OsScheduleTable)
