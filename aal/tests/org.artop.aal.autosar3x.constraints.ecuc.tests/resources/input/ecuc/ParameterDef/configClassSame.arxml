AUTOSAR XML (schema 3-2-1)
# The material contained in this specification is protected by copyright and
# other types of Intellectual Property Rights. The commercial exploitation of
# the material contained in this specification requires a license to such
# Intellectual Property Rights.
# This specification may be utilized or reproduced without any modification, in
# any form or by any means, for informational purposes only.
# For any other purpose, no part of the specification may be utilized or
# reproduced, in any form or by any means, without permission in writing from
# the publisher.
# licensed under the same rules as applicable to the AUTOSAR Standard.
package /ARPackage1
  module definition ModuleDef [0..1]: variants pre-compile
    container MemMapAddressingModeSet [0..1]
      enumeration MemMapSupportedMemoryAllocationKeywordPolicy [0..1]: set at pre-compile, origin=AUTOSAR
package /ARPackage2
  module definition ModuleDef [0..1]: refined-module-def=ARPackage1/ModuleDef, variants pre-compile
    container MemMapAddressingModeSet [0..1]
      enumeration MemMapSupportedMemoryAllocationKeywordPolicy [0..1]: set at pre-compile, origin=AUTOSAR, set at 
