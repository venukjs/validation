AUTOSAR XML (schema 3.1.4)
package /OS_Package1
  module config OS_ModuleConfiguration: definition=Os_2, implementation-config-variant=VARIANT-PRE-COMPILE
    OS_ChoiceContainer (ParamConfContainerDef1)
package /AUTOSAR
  module definition Os
    container ParamConfContainerDef1
  module definition Os_2
    container ParamConfContainerDef
