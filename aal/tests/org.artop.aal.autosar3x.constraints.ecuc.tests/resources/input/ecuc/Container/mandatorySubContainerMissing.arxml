AUTOSAR XML (schema 3.1.1)
package /OS_Package1
  module config OS_ModuleConfiguration: definition=Os, implementation-config-variant=VARIANT-PRE-COMPILE
    OS_Container (ParamConfContainerDef)
package /AUTOSAR
  module definition Os
    container ParamConfContainerDef
      container SubContainerDef [1..*]
