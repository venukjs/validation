AUTOSAR XML (schema 3.1.1)
package /OS_Package1
  module config OS_ModuleConfiguration1: definition=Os, implementation-config-variant=VARIANT-PRE-COMPILE
    OS_ChoiceContainer1 (ChoiceContainerDef)
      OS_Choice1 (Alternative1)
  module config OS_ModuleConfiguration1: definition=Os, implementation-config-variant=VARIANT-PRE-COMPILE
    OS_ChoiceContainer1 (ChoiceContainerDef)
      OS_Choice2 (Alternative2)
package /AUTOSAR
  module definition Os
    choice container ChoiceContainerDef
      container Alternative1
      container Alternative2
