AUTOSAR XML (schema 3.1.2)
package /OS_Package1
  module config OS_ModuleConfiguration: definition=Os, implementation-config-variant=VARIANT-PRE-COMPILE
    OS_ChoiceContainer (ChoiceContainerDef1)
      OS_Choice (Alternative1)
    OS_Container (ParamConfContainerDef1)
      OS_SubContainer (SubContainerDef1)
  module config OS_ModuleConfiguration: definition=Os, implementation-config-variant=VARIANT-PRE-COMPILE
    OS_ChoiceContainer (ChoiceContainerDef1)
      OS_Choice (Alternative1)
    OS_Container (ParamConfContainerDef1)
      OS_SubContainer (SubContainerDef1)
  module config OS_ModuleConfiguration: definition=Os, implementation-config-variant=VARIANT-PRE-COMPILE
    OS_ChoiceContainer (ChoiceContainerDef1)
      OS_Choice (Alternative1)
    OS_Container (ParamConfContainerDef1)
      OS_SubContainer (SubContainerDef1)
  module config OS_ModuleConfiguration: definition=Os, implementation-config-variant=VARIANT-PRE-COMPILE
    OS_ChoiceContainer (ChoiceContainerDef1)
      OS_Choice (Alternative1)
    OS_Container (ParamConfContainerDef1)
      OS_SubContainer (SubContainerDef1)
  module config OS_ModuleConfiguration: definition=Os, implementation-config-variant=VARIANT-PRE-COMPILE
    OS_ChoiceContainer (ChoiceContainerDef1)
      OS_Choice (Alternative1)
    OS_Container (ParamConfContainerDef1)
      OS_SubContainer (SubContainerDef1)
  module config OS_ModuleConfiguration: definition=Os, implementation-config-variant=VARIANT-PRE-COMPILE
    OS_ChoiceContainer (ChoiceContainerDef1)
      OS_Choice (Alternative1)
    OS_Container (ParamConfContainerDef1)
      OS_SubContainer (SubContainerDef1)
  module config OS_ModuleConfiguration: definition=Os, implementation-config-variant=VARIANT-PRE-COMPILE
    OS_ChoiceContainer (ChoiceContainerDef1)
      OS_Choice (Alternative1)
    OS_Container (ParamConfContainerDef1)
      OS_SubContainer (SubContainerDef1)
  module config OS_ModuleConfiguration: definition=Os, implementation-config-variant=VARIANT-PRE-COMPILE
    OS_ChoiceContainer (ChoiceContainerDef1)
      OS_Choice (Alternative1)
    OS_Container (ParamConfContainerDef1)
      OS_SubContainer (SubContainerDef1)
  module config OS_ModuleConfiguration: definition=Os, implementation-config-variant=VARIANT-PRE-COMPILE
    OS_ChoiceContainer (ChoiceContainerDef1)
      OS_Choice (Alternative1)
    OS_Container (ParamConfContainerDef1)
      OS_SubContainer (SubContainerDef1)
  module config OS_ModuleConfiguration: definition=Os, implementation-config-variant=VARIANT-PRE-COMPILE
    OS_ChoiceContainer (ChoiceContainerDef1)
      OS_Choice (Alternative1)
    OS_Container (ParamConfContainerDef1)
      OS_SubContainer (SubContainerDef1)
  module config OS_ModuleConfiguration: definition=Os, implementation-config-variant=VARIANT-PRE-COMPILE
    OS_ChoiceContainer (ChoiceContainerDef1)
      OS_Choice (Alternative1)
    OS_Container (ParamConfContainerDef1)
      OS_SubContainer (SubContainerDef1)
  module config OS_ModuleConfiguration: definition=Os, implementation-config-variant=VARIANT-PRE-COMPILE
    OS_ChoiceContainer (ChoiceContainerDef1)
      OS_Choice (Alternative1)
    OS_Container (ParamConfContainerDef1)
      OS_SubContainer (SubContainerDef1)
  module config OS_ModuleConfiguration: definition=Os, implementation-config-variant=VARIANT-PRE-COMPILE
    OS_ChoiceContainer (ChoiceContainerDef1)
      OS_Choice (Alternative1)
    OS_Container (ParamConfContainerDef1)
      OS_SubContainer (SubContainerDef1)
  module config OS_ModuleConfiguration: definition=Os, implementation-config-variant=VARIANT-PRE-COMPILE
    OS_ChoiceContainer (ChoiceContainerDef1)
      OS_Choice (Alternative1)
    OS_Container (ParamConfContainerDef1)
      OS_SubContainer (SubContainerDef1)
  module config OS_ModuleConfiguration: definition=Os, implementation-config-variant=VARIANT-PRE-COMPILE
    OS_ChoiceContainer (ChoiceContainerDef1)
      OS_Choice (Alternative1)
    OS_Container (ParamConfContainerDef1)
      OS_SubContainer (SubContainerDef1)
  module config OS_ModuleConfiguration: definition=Os, implementation-config-variant=VARIANT-PRE-COMPILE
    OS_ChoiceContainer (ChoiceContainerDef1)
      OS_Choice (Alternative1)
    OS_Container (ParamConfContainerDef1)
      OS_SubContainer (SubContainerDef1)
  module config OS_ModuleConfiguration: definition=Os, implementation-config-variant=VARIANT-PRE-COMPILE
    OS_ChoiceContainer (ChoiceContainerDef1)
      OS_Choice (Alternative1)
    OS_Container (ParamConfContainerDef1)
      OS_SubContainer (SubContainerDef1)
  module config OS_ModuleConfiguration: definition=Os, implementation-config-variant=VARIANT-PRE-COMPILE
    OS_ChoiceContainer (ChoiceContainerDef1)
      OS_Choice (Alternative1)
    OS_Container (ParamConfContainerDef1)
      OS_SubContainer (SubContainerDef1)
  module config OS_ModuleConfiguration: definition=Os, implementation-config-variant=VARIANT-PRE-COMPILE
    OS_ChoiceContainer (ChoiceContainerDef1)
      OS_Choice (Alternative1)
    OS_Container (ParamConfContainerDef1)
      OS_SubContainer (SubContainerDef1)
  module config OS_ModuleConfiguration: definition=Os, implementation-config-variant=VARIANT-PRE-COMPILE
    OS_ChoiceContainer (ChoiceContainerDef1)
      OS_Choice (Alternative1)
    OS_Container (ParamConfContainerDef1)
      OS_SubContainer (SubContainerDef1)
  module config OS_ModuleConfiguration: definition=Os, implementation-config-variant=VARIANT-PRE-COMPILE
    OS_ChoiceContainer (ChoiceContainerDef1)
      OS_Choice (Alternative1)
    OS_Container (ParamConfContainerDef1)
      OS_SubContainer (SubContainerDef1)
  module config OS_ModuleConfiguration: definition=Os, implementation-config-variant=VARIANT-PRE-COMPILE
    OS_ChoiceContainer (ChoiceContainerDef1)
      OS_Choice (Alternative1)
    OS_Container (ParamConfContainerDef1)
      OS_SubContainer (SubContainerDef1)
  module config OS_ModuleConfiguration: definition=Os, implementation-config-variant=VARIANT-PRE-COMPILE
    OS_ChoiceContainer (ChoiceContainerDef1)
      OS_Choice (Alternative1)
    OS_Container (ParamConfContainerDef1)
      OS_SubContainer (SubContainerDef1)
  module config OS_ModuleConfiguration: definition=Os, implementation-config-variant=VARIANT-PRE-COMPILE
    OS_ChoiceContainer (ChoiceContainerDef1)
      OS_Choice (Alternative1)
    OS_Container (ParamConfContainerDef1)
      OS_SubContainer (SubContainerDef1)
  module config OS_ModuleConfiguration: definition=Os, implementation-config-variant=VARIANT-PRE-COMPILE
    OS_ChoiceContainer (ChoiceContainerDef1)
      OS_Choice (Alternative1)
    OS_Container (ParamConfContainerDef1)
      OS_SubContainer (SubContainerDef1)
  module config OS_ModuleConfiguration: definition=Os, implementation-config-variant=VARIANT-PRE-COMPILE
    OS_ChoiceContainer (ChoiceContainerDef1)
      OS_Choice (Alternative1)
    OS_Container (ParamConfContainerDef1)
      OS_SubContainer (SubContainerDef1)
  module config OS_ModuleConfiguration: definition=Os, implementation-config-variant=VARIANT-PRE-COMPILE
    OS_ChoiceContainer (ChoiceContainerDef1)
      OS_Choice (Alternative1)
    OS_Container (ParamConfContainerDef1)
      OS_SubContainer (SubContainerDef1)
  module config OS_ModuleConfiguration: definition=Os, implementation-config-variant=VARIANT-PRE-COMPILE
    OS_ChoiceContainer (ChoiceContainerDef1)
      OS_Choice (Alternative1)
    OS_Container (ParamConfContainerDef1)
      OS_SubContainer (SubContainerDef1)
  module config OS_ModuleConfiguration: definition=Os, implementation-config-variant=VARIANT-PRE-COMPILE
    OS_ChoiceContainer (ChoiceContainerDef1)
      OS_Choice (Alternative1)
    OS_Container (ParamConfContainerDef1)
      OS_SubContainer (SubContainerDef1)
  module config OS_ModuleConfiguration: definition=Os, implementation-config-variant=VARIANT-PRE-COMPILE
    OS_ChoiceContainer (ChoiceContainerDef1)
      OS_Choice (Alternative1)
    OS_Container (ParamConfContainerDef1)
      OS_SubContainer (SubContainerDef1)
  module config OS_ModuleConfiguration: definition=Os, implementation-config-variant=VARIANT-PRE-COMPILE
    OS_ChoiceContainer (ChoiceContainerDef1)
      OS_Choice (Alternative1)
    OS_Container (ParamConfContainerDef1)
      OS_SubContainer (SubContainerDef1)
  module config OS_ModuleConfiguration: definition=Os, implementation-config-variant=VARIANT-PRE-COMPILE
    OS_ChoiceContainer (ChoiceContainerDef1)
      OS_Choice (Alternative1)
    OS_Container (ParamConfContainerDef1)
      OS_SubContainer (SubContainerDef1)
  module config OS_ModuleConfiguration: definition=Os, implementation-config-variant=VARIANT-PRE-COMPILE
    OS_ChoiceContainer (ChoiceContainerDef1)
      OS_Choice (Alternative1)
    OS_Container (ParamConfContainerDef1)
      OS_SubContainer (SubContainerDef1)
  module config OS_ModuleConfiguration: definition=Os, implementation-config-variant=VARIANT-PRE-COMPILE
    OS_ChoiceContainer (ChoiceContainerDef1)
      OS_Choice (Alternative1)
    OS_Container (ParamConfContainerDef1)
      OS_SubContainer (SubContainerDef1)
  module config OS_ModuleConfiguration: definition=Os, implementation-config-variant=VARIANT-PRE-COMPILE
    OS_ChoiceContainer (ChoiceContainerDef1)
      OS_Choice (Alternative1)
    OS_Container (ParamConfContainerDef1)
      OS_SubContainer (SubContainerDef1)
  module config OS_ModuleConfiguration: definition=Os, implementation-config-variant=VARIANT-PRE-COMPILE
    OS_ChoiceContainer (ChoiceContainerDef1)
      OS_Choice (Alternative1)
    OS_Container (ParamConfContainerDef1)
      OS_SubContainer (SubContainerDef1)
  module config OS_ModuleConfiguration: definition=Os, implementation-config-variant=VARIANT-PRE-COMPILE
    OS_ChoiceContainer (ChoiceContainerDef1)
      OS_Choice (Alternative1)
    OS_Container (ParamConfContainerDef1)
      OS_SubContainer (SubContainerDef1)
  module config OS_ModuleConfiguration: definition=Os, implementation-config-variant=VARIANT-PRE-COMPILE
    OS_ChoiceContainer (ChoiceContainerDef1)
      OS_Choice (Alternative1)
    OS_Container (ParamConfContainerDef1)
      OS_SubContainer (SubContainerDef1)
  module config OS_ModuleConfiguration: definition=Os, implementation-config-variant=VARIANT-PRE-COMPILE
    OS_ChoiceContainer (ChoiceContainerDef1)
      OS_Choice (Alternative1)
    OS_Container (ParamConfContainerDef1)
      OS_SubContainer (SubContainerDef1)
  module config OS_ModuleConfiguration: definition=Os, implementation-config-variant=VARIANT-PRE-COMPILE
    OS_ChoiceContainer (ChoiceContainerDef1)
      OS_Choice (Alternative1)
    OS_Container (ParamConfContainerDef1)
      OS_SubContainer (SubContainerDef1)
  module config OS_ModuleConfiguration: definition=Os, implementation-config-variant=VARIANT-PRE-COMPILE
    OS_ChoiceContainer (ChoiceContainerDef1)
      OS_Choice (Alternative1)
    OS_Container (ParamConfContainerDef1)
      OS_SubContainer (SubContainerDef1)
  module config OS_ModuleConfiguration: definition=Os, implementation-config-variant=VARIANT-PRE-COMPILE
    OS_ChoiceContainer (ChoiceContainerDef1)
      OS_Choice (Alternative1)
    OS_Container (ParamConfContainerDef1)
      OS_SubContainer (SubContainerDef1)
  module config OS_ModuleConfiguration: definition=Os, implementation-config-variant=VARIANT-PRE-COMPILE
    OS_ChoiceContainer (ChoiceContainerDef1)
      OS_Choice (Alternative1)
    OS_Container (ParamConfContainerDef1)
      OS_SubContainer (SubContainerDef1)
  module config OS_ModuleConfiguration: definition=Os, implementation-config-variant=VARIANT-PRE-COMPILE
    OS_ChoiceContainer (ChoiceContainerDef1)
      OS_Choice (Alternative1)
    OS_Container (ParamConfContainerDef1)
      OS_SubContainer (SubContainerDef1)
  module config OS_ModuleConfiguration: definition=Os, implementation-config-variant=VARIANT-PRE-COMPILE
    OS_ChoiceContainer (ChoiceContainerDef1)
      OS_Choice (Alternative1)
    OS_Container (ParamConfContainerDef1)
      OS_SubContainer (SubContainerDef1)
  module config OS_ModuleConfiguration: definition=Os, implementation-config-variant=VARIANT-PRE-COMPILE
    OS_ChoiceContainer (ChoiceContainerDef1)
      OS_Choice (Alternative1)
    OS_Container (ParamConfContainerDef1)
      OS_SubContainer (SubContainerDef1)
  module config OS_ModuleConfiguration: definition=Os, implementation-config-variant=VARIANT-PRE-COMPILE
    OS_ChoiceContainer (ChoiceContainerDef1)
      OS_Choice (Alternative1)
    OS_Container (ParamConfContainerDef1)
      OS_SubContainer (SubContainerDef1)
  module config OS_ModuleConfiguration: definition=Os, implementation-config-variant=VARIANT-PRE-COMPILE
    OS_ChoiceContainer (ChoiceContainerDef1)
      OS_Choice (Alternative1)
    OS_Container (ParamConfContainerDef1)
      OS_SubContainer (SubContainerDef1)
  module config OS_ModuleConfiguration: definition=Os, implementation-config-variant=VARIANT-PRE-COMPILE
    OS_ChoiceContainer (ChoiceContainerDef1)
      OS_Choice (Alternative1)
    OS_Container (ParamConfContainerDef1)
      OS_SubContainer (SubContainerDef1)
  module config OS_ModuleConfiguration: definition=Os, implementation-config-variant=VARIANT-PRE-COMPILE
    OS_ChoiceContainer (ChoiceContainerDef1)
      OS_Choice (Alternative1)
    OS_Container (ParamConfContainerDef1)
      OS_SubContainer (SubContainerDef1)
  module config OS_ModuleConfiguration: definition=Os, implementation-config-variant=VARIANT-PRE-COMPILE
    OS_ChoiceContainer (ChoiceContainerDef1)
      OS_Choice (Alternative1)
    OS_Container (ParamConfContainerDef1)
      OS_SubContainer (SubContainerDef1)
  module config OS_ModuleConfiguration: definition=Os, implementation-config-variant=VARIANT-PRE-COMPILE
    OS_ChoiceContainer (ChoiceContainerDef1)
      OS_Choice (Alternative1)
    OS_Container (ParamConfContainerDef1)
      OS_SubContainer (SubContainerDef1)
  module config OS_ModuleConfiguration: definition=Os, implementation-config-variant=VARIANT-PRE-COMPILE
    OS_ChoiceContainer (ChoiceContainerDef1)
      OS_Choice (Alternative1)
    OS_Container (ParamConfContainerDef1)
      OS_SubContainer (SubContainerDef1)
  module config OS_ModuleConfiguration: definition=Os, implementation-config-variant=VARIANT-PRE-COMPILE
    OS_ChoiceContainer (ChoiceContainerDef1)
      OS_Choice (Alternative1)
    OS_Container (ParamConfContainerDef1)
      OS_SubContainer (SubContainerDef1)
  module config OS_ModuleConfiguration: definition=Os, implementation-config-variant=VARIANT-PRE-COMPILE
    OS_ChoiceContainer (ChoiceContainerDef1)
      OS_Choice (Alternative1)
    OS_Container (ParamConfContainerDef1)
      OS_SubContainer (SubContainerDef1)
  module config OS_ModuleConfiguration: definition=Os, implementation-config-variant=VARIANT-PRE-COMPILE
    OS_ChoiceContainer (ChoiceContainerDef1)
      OS_Choice (Alternative1)
    OS_Container (ParamConfContainerDef1)
      OS_SubContainer (SubContainerDef1)
  module config OS_ModuleConfiguration: definition=Os, implementation-config-variant=VARIANT-PRE-COMPILE
    OS_ChoiceContainer (ChoiceContainerDef1)
      OS_Choice (Alternative1)
    OS_Container (ParamConfContainerDef1)
      OS_SubContainer (SubContainerDef1)
  module config OS_ModuleConfiguration: definition=Os, implementation-config-variant=VARIANT-PRE-COMPILE
    OS_ChoiceContainer (ChoiceContainerDef1)
      OS_Choice (Alternative1)
    OS_Container (ParamConfContainerDef1)
      OS_SubContainer (SubContainerDef1)
  module config OS_ModuleConfiguration: definition=Os, implementation-config-variant=VARIANT-PRE-COMPILE
    OS_ChoiceContainer (ChoiceContainerDef1)
      OS_Choice (Alternative1)
    OS_Container (ParamConfContainerDef1)
      OS_SubContainer (SubContainerDef1)
  module config OS_ModuleConfiguration: definition=Os, implementation-config-variant=VARIANT-PRE-COMPILE
    OS_ChoiceContainer (ChoiceContainerDef1)
      OS_Choice (Alternative1)
    OS_Container (ParamConfContainerDef1)
      OS_SubContainer (SubContainerDef1)
  module config OS_ModuleConfiguration: definition=Os, implementation-config-variant=VARIANT-PRE-COMPILE
    OS_ChoiceContainer (ChoiceContainerDef1)
      OS_Choice (Alternative1)
    OS_Container (ParamConfContainerDef1)
      OS_SubContainer (SubContainerDef1)
  module config OS_ModuleConfiguration: definition=Os, implementation-config-variant=VARIANT-PRE-COMPILE
    OS_ChoiceContainer (ChoiceContainerDef1)
      OS_Choice (Alternative1)
    OS_Container (ParamConfContainerDef1)
      OS_SubContainer (SubContainerDef1)
  module config OS_ModuleConfiguration: definition=Os, implementation-config-variant=VARIANT-PRE-COMPILE
    OS_ChoiceContainer (ChoiceContainerDef1)
      OS_Choice (Alternative1)
    OS_Container (ParamConfContainerDef1)
      OS_SubContainer (SubContainerDef1)
  module config OS_ModuleConfiguration: definition=Os, implementation-config-variant=VARIANT-PRE-COMPILE
    OS_ChoiceContainer (ChoiceContainerDef1)
      OS_Choice (Alternative1)
    OS_Container (ParamConfContainerDef1)
      OS_SubContainer (SubContainerDef1)
  module config OS_ModuleConfiguration: definition=Os, implementation-config-variant=VARIANT-PRE-COMPILE
    OS_ChoiceContainer (ChoiceContainerDef1)
      OS_Choice (Alternative1)
    OS_Container (ParamConfContainerDef1)
      OS_SubContainer (SubContainerDef1)
  module config OS_ModuleConfiguration: definition=Os, implementation-config-variant=VARIANT-PRE-COMPILE
    OS_ChoiceContainer (ChoiceContainerDef1)
      OS_Choice (Alternative1)
    OS_Container (ParamConfContainerDef1)
      OS_SubContainer (SubContainerDef1)
  module config OS_ModuleConfiguration: definition=Os, implementation-config-variant=VARIANT-PRE-COMPILE
    OS_ChoiceContainer (ChoiceContainerDef1)
      OS_Choice (Alternative1)
    OS_Container (ParamConfContainerDef1)
      OS_SubContainer (SubContainerDef1)
  module config OS_ModuleConfiguration: definition=Os, implementation-config-variant=VARIANT-PRE-COMPILE
    OS_ChoiceContainer (ChoiceContainerDef1)
      OS_Choice (Alternative1)
    OS_Container (ParamConfContainerDef1)
      OS_SubContainer (SubContainerDef1)
  module config OS_ModuleConfiguration: definition=Os, implementation-config-variant=VARIANT-PRE-COMPILE
    OS_ChoiceContainer (ChoiceContainerDef1)
      OS_Choice (Alternative1)
    OS_Container (ParamConfContainerDef1)
      OS_SubContainer (SubContainerDef1)
  module config OS_ModuleConfiguration: definition=Os, implementation-config-variant=VARIANT-PRE-COMPILE
    OS_ChoiceContainer (ChoiceContainerDef1)
      OS_Choice (Alternative1)
    OS_Container (ParamConfContainerDef1)
      OS_SubContainer (SubContainerDef1)
  module config OS_ModuleConfiguration: definition=Os, implementation-config-variant=VARIANT-PRE-COMPILE
    OS_ChoiceContainer (ChoiceContainerDef1)
      OS_Choice (Alternative1)
    OS_Container (ParamConfContainerDef1)
      OS_SubContainer (SubContainerDef1)
  module config OS_ModuleConfiguration: definition=Os, implementation-config-variant=VARIANT-PRE-COMPILE
    OS_ChoiceContainer (ChoiceContainerDef1)
      OS_Choice (Alternative1)
    OS_Container (ParamConfContainerDef1)
      OS_SubContainer (SubContainerDef1)
  module config OS_ModuleConfiguration: definition=Os, implementation-config-variant=VARIANT-PRE-COMPILE
    OS_ChoiceContainer (ChoiceContainerDef1)
      OS_Choice (Alternative1)
    OS_Container (ParamConfContainerDef1)
      OS_SubContainer (SubContainerDef1)
  module config OS_ModuleConfiguration: definition=Os, implementation-config-variant=VARIANT-PRE-COMPILE
    OS_ChoiceContainer (ChoiceContainerDef1)
      OS_Choice (Alternative1)
    OS_Container (ParamConfContainerDef1)
      OS_SubContainer (SubContainerDef1)
  module config OS_ModuleConfiguration: definition=Os, implementation-config-variant=VARIANT-PRE-COMPILE
    OS_ChoiceContainer (ChoiceContainerDef1)
      OS_Choice (Alternative1)
    OS_Container (ParamConfContainerDef1)
      OS_SubContainer (SubContainerDef1)
  module config OS_ModuleConfiguration: definition=Os, implementation-config-variant=VARIANT-PRE-COMPILE
    OS_ChoiceContainer (ChoiceContainerDef1)
      OS_Choice (Alternative1)
    OS_Container (ParamConfContainerDef1)
      OS_SubContainer (SubContainerDef1)
  module config OS_ModuleConfiguration: definition=Os, implementation-config-variant=VARIANT-PRE-COMPILE
    OS_ChoiceContainer (ChoiceContainerDef1)
      OS_Choice (Alternative1)
    OS_Container (ParamConfContainerDef1)
      OS_SubContainer (SubContainerDef1)
  module config OS_ModuleConfiguration: definition=Os, implementation-config-variant=VARIANT-PRE-COMPILE
    OS_ChoiceContainer (ChoiceContainerDef1)
      OS_Choice (Alternative1)
    OS_Container (ParamConfContainerDef1)
      OS_SubContainer (SubContainerDef1)
  module config OS_ModuleConfiguration: definition=Os, implementation-config-variant=VARIANT-PRE-COMPILE
    OS_ChoiceContainer (ChoiceContainerDef1)
      OS_Choice (Alternative1)
    OS_Container (ParamConfContainerDef1)
      OS_SubContainer (SubContainerDef1)
  module config OS_ModuleConfiguration: definition=Os, implementation-config-variant=VARIANT-PRE-COMPILE
    OS_ChoiceContainer (ChoiceContainerDef1)
      OS_Choice (Alternative1)
    OS_Container (ParamConfContainerDef1)
      OS_SubContainer (SubContainerDef1)
  module config OS_ModuleConfiguration: definition=Os, implementation-config-variant=VARIANT-PRE-COMPILE
    OS_ChoiceContainer (ChoiceContainerDef1)
      OS_Choice (Alternative1)
    OS_Container (ParamConfContainerDef1)
      OS_SubContainer (SubContainerDef1)
  module config OS_ModuleConfiguration: definition=Os, implementation-config-variant=VARIANT-PRE-COMPILE
    OS_ChoiceContainer (ChoiceContainerDef1)
      OS_Choice (Alternative1)
    OS_Container (ParamConfContainerDef1)
      OS_SubContainer (SubContainerDef1)
  module config OS_ModuleConfiguration: definition=Os, implementation-config-variant=VARIANT-PRE-COMPILE
    OS_ChoiceContainer (ChoiceContainerDef1)
      OS_Choice (Alternative1)
    OS_Container (ParamConfContainerDef1)
      OS_SubContainer (SubContainerDef1)
  module config OS_ModuleConfiguration: definition=Os, implementation-config-variant=VARIANT-PRE-COMPILE
    OS_ChoiceContainer (ChoiceContainerDef1)
      OS_Choice (Alternative1)
    OS_Container (ParamConfContainerDef1)
      OS_SubContainer (SubContainerDef1)
  module config OS_ModuleConfiguration: definition=Os, implementation-config-variant=VARIANT-PRE-COMPILE
    OS_ChoiceContainer (ChoiceContainerDef1)
      OS_Choice (Alternative1)
    OS_Container (ParamConfContainerDef1)
      OS_SubContainer (SubContainerDef1)
  module config OS_ModuleConfiguration: definition=Os, implementation-config-variant=VARIANT-PRE-COMPILE
    OS_ChoiceContainer (ChoiceContainerDef1)
      OS_Choice (Alternative1)
    OS_Container (ParamConfContainerDef1)
      OS_SubContainer (SubContainerDef1)
  module config OS_ModuleConfiguration: definition=Os, implementation-config-variant=VARIANT-PRE-COMPILE
    OS_ChoiceContainer (ChoiceContainerDef1)
      OS_Choice (Alternative1)
    OS_Container (ParamConfContainerDef1)
      OS_SubContainer (SubContainerDef1)
  module config OS_ModuleConfiguration: definition=Os, implementation-config-variant=VARIANT-PRE-COMPILE
    OS_ChoiceContainer (ChoiceContainerDef1)
      OS_Choice (Alternative1)
    OS_Container (ParamConfContainerDef1)
      OS_SubContainer (SubContainerDef1)
  module config OS_ModuleConfiguration: definition=Os, implementation-config-variant=VARIANT-PRE-COMPILE
    OS_ChoiceContainer (ChoiceContainerDef1)
      OS_Choice (Alternative1)
    OS_Container (ParamConfContainerDef1)
      OS_SubContainer (SubContainerDef1)
  module config OS_ModuleConfiguration: definition=Os, implementation-config-variant=VARIANT-PRE-COMPILE
    OS_ChoiceContainer (ChoiceContainerDef1)
      OS_Choice (Alternative1)
    OS_Container (ParamConfContainerDef1)
      OS_SubContainer (SubContainerDef1)
  module config OS_ModuleConfiguration: definition=Os, implementation-config-variant=VARIANT-PRE-COMPILE
    OS_ChoiceContainer (ChoiceContainerDef1)
      OS_Choice (Alternative1)
    OS_Container (ParamConfContainerDef1)
      OS_SubContainer (SubContainerDef1)
  module config OS_ModuleConfiguration: definition=Os, implementation-config-variant=VARIANT-PRE-COMPILE
    OS_ChoiceContainer (ChoiceContainerDef1)
      OS_Choice (Alternative1)
    OS_Container (ParamConfContainerDef1)
      OS_SubContainer (SubContainerDef1)
  module config OS_ModuleConfiguration: definition=Os, implementation-config-variant=VARIANT-PRE-COMPILE
    OS_ChoiceContainer (ChoiceContainerDef1)
      OS_Choice (Alternative1)
    OS_Container (ParamConfContainerDef1)
      OS_SubContainer (SubContainerDef1)
  module config OS_ModuleConfiguration: definition=Os, implementation-config-variant=VARIANT-PRE-COMPILE
    OS_ChoiceContainer (ChoiceContainerDef1)
      OS_Choice (Alternative1)
    OS_Container (ParamConfContainerDef1)
      OS_SubContainer (SubContainerDef1)
  module config OS_ModuleConfiguration: definition=Os, implementation-config-variant=VARIANT-PRE-COMPILE
    OS_ChoiceContainer (ChoiceContainerDef1)
      OS_Choice (Alternative1)
    OS_Container (ParamConfContainerDef1)
      OS_SubContainer (SubContainerDef1)
  module config OS_ModuleConfiguration: definition=Os, implementation-config-variant=VARIANT-PRE-COMPILE
    OS_ChoiceContainer (ChoiceContainerDef1)
      OS_Choice (Alternative1)
    OS_Container (ParamConfContainerDef1)
      OS_SubContainer (SubContainerDef1)
  module config OS_ModuleConfiguration: definition=Os, implementation-config-variant=VARIANT-PRE-COMPILE
    OS_ChoiceContainer (ChoiceContainerDef1)
      OS_Choice (Alternative1)
    OS_Container (ParamConfContainerDef1)
      OS_SubContainer (SubContainerDef1)
  module config OS_ModuleConfiguration: definition=Os, implementation-config-variant=VARIANT-PRE-COMPILE
    OS_ChoiceContainer (ChoiceContainerDef1)
      OS_Choice (Alternative1)
    OS_Container (ParamConfContainerDef1)
      OS_SubContainer (SubContainerDef1)
  module config OS_ModuleConfiguration: definition=Os, implementation-config-variant=VARIANT-PRE-COMPILE
    OS_ChoiceContainer (ChoiceContainerDef1)
      OS_Choice (Alternative1)
    OS_Container (ParamConfContainerDef1)
      OS_SubContainer (SubContainerDef1)
  module config OS_ModuleConfiguration: definition=Os, implementation-config-variant=VARIANT-PRE-COMPILE
    OS_ChoiceContainer (ChoiceContainerDef1)
      OS_Choice (Alternative1)
    OS_Container (ParamConfContainerDef1)
      OS_SubContainer (SubContainerDef1)
package /AUTOSAR
  module definition Os
    choice container ChoiceContainerDef1
      container Alternative1 [0..1]
      container Alternative2 [0..1]
    container ParamConfContainerDef1
      container SubContainerDef1
