AUTOSAR XML (schema 3.1.1)
package /OS_Package1
  module config OS_ModuleConfiguration: definition=Os, implementation-config-variant=VARIANT-PRE-COMPILE
    OS_ChoiceContainer (ChoiceContainerDef1)
      OS_Choice (ParamConfContainerDef1)
package /AUTOSAR
  module definition Os
    choice container ChoiceContainerDef1
      container Alternative1
      container Alternative2
    container ParamConfContainerDef1
      container SubContainerDef1
