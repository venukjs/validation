AUTOSAR XML (schema 3.1.1)
package /AUTOSAR
  module definition Os [-1..1]: variants post-build
