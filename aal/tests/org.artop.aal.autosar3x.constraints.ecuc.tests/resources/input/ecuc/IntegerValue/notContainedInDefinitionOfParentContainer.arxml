AUTOSAR XML (schema 3.1.1)
package /p
  module config configuration: definition=Os, implementation-config-variant=VARIANT-PRE-COMPILE
    container (OsAlarm1): SomeIntegerDef=true
package /AUTOSAR
  module definition Os
    container OsAlarm1
      boolean OsAppErrorHook1
    container OsAlarm2
      integer SomeIntegerDef
