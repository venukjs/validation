AUTOSAR XML (schema 3.1.1)
package /p
  module config configuration: definition=Os, implementation-config-variant=VARIANT-PRE-COMPILE
    container (OsAlarm): OsAppErrorHookkkk=666
package /AUTOSAR
  module definition Os
    container OsAlarm
      integer OsAppErrorHookkkk: 0..0
