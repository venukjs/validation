AUTOSAR XML (schema 3.1.4)
package /p
  module config configuration: definition=Os, implementation-config-variant=VARIANT-PRE-COMPILE
    container (OsAlarm1Choice): SomeIntegerDef=true
package /AUTOSAR
  module definition Os
    container OsAlarm1
      integer SomeIntegerDef
    choice container OsAlarm1Choice
      container OsAlarm1Choice_Container
        boolean OsAppErrorHook1_Choice
