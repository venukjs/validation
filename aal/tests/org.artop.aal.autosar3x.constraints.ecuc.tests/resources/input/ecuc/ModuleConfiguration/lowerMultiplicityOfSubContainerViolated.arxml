AUTOSAR XML (schema 3.1.1)
package /p
  module config configuration: definition=Os, implementation-config-variant=VARIANT-POST-BUILD
    container1 (OsAlarm1)
package /AUTOSAR
  module definition Os: variants post-build
    container OsAlarm1 [2..*]
