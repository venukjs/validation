AUTOSAR XML (schema 3.1.1)
package /p
  module config proxyDefiniton: implementation-config-variant=VARIANT-PRE-COMPILE, definition=/
package /AUTOSAR
  module definition Os
