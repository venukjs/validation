AUTOSAR XML (schema 3.1.1)
package /p
  module config configuration: definition=Os
    container (OsAlarm)
package /AUTOSAR
  module definition Os: variants post-build
    container OsAlarm
      boolean BooleanParameter: default-value=false
