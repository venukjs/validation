AUTOSAR XML (schema 3.1.1)
package /p
  module config configuration: implementation-config-variant=VARIANT-PRE-COMPILE
package /AUTOSAR
  module definition Os
