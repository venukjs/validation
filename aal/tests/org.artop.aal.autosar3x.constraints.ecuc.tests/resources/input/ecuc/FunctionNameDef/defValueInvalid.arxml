AUTOSAR XML (schema 3-1-1)
package /TEST
  module definition ModuleDef
    container Functions
      function name Function0: default-value=9//
