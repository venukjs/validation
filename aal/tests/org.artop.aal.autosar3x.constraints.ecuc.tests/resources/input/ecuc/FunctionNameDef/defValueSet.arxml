AUTOSAR XML (schema 3-1-1)
package /TEST
  module definition ModuleDef
    container Functions: parameters=function-name-def=default-value=default
