AUTOSAR XML (schema 3.1.1)
package /AUTOSAR
  module definition Os
    container OsApplication
      reference OsAppScheduleTableRef: destination=OsScheduleTable
    container OsResource
    container OsScheduleTable
package /OS_Package
  module config OS_ModuleConfiguration: definition=Os, implementation-config-variant=VARIANT-PRE-COMPILE
    OS_OsApplication (OsApplication): OsAppScheduleTableRef=OS_OsScheduleTable
    OS_OsScheduleTable (OsResource)
