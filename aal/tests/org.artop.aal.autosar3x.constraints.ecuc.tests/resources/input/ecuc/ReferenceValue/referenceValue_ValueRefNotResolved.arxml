AUTOSAR XML (schema 3-2-1)
package /AUTOSAR
  module definition Vendor_Module
    container ContainerDef
      choice reference ChoiceReferenceParamDef: destination=TargetContainerDef
    container TargetContainerDef
  module config myVendor_Module: definition=Vendor_Module
    Container (ContainerDef): ChoiceReferenceParamDef=TargetContainerDef
