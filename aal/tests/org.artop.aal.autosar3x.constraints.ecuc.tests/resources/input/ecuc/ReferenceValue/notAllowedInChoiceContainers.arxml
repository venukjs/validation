AUTOSAR XML (schema 3.1.4)
package /AUTOSAR
  module definition Os
    container OsApplication
      reference OsAppScheduleTableRef: destination=OsScheduleTable
    container OsApplication2
      reference OsAppScheduleTableRef2: destination=OsScheduleTable
    container OsScheduleTable
    choice container OsApplication_Choice
      container OsApplication_Container
        reference OsAppScheduleTableRef_fromChoice: destination=OsScheduleTable
package /OS_Package
  module config OS_ModuleConfiguration: definition=Os, implementation-config-variant=VARIANT-PRE-COMPILE
    OS_OsApplication (OsApplication_Choice): OsAppScheduleTableRef_fromChoice=OS_OsScheduleTable
    OS_OsScheduleTable (OsScheduleTable)
