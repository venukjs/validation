AUTOSAR XML
package /p
  module config configuration: definition=Os, implementation-config-variant=VARIANT-PRE-COMPILE
    container (OsAlarm): OsAppErrorHookFloat=(unset)
package /AUTOSAR
  module definition Os
    container OsAlarm
      float OsAppErrorHookFloat
