AUTOSAR XML (schema 4-0-3)
package /p
  module config configuration: definition=Os, implementation-config-variant=VARIANT-POST-BUILD
    container1 (OsAlarm)
      containerSub1 (OsAlarmSub)
      containerSub2 (OsAlarmSub)
package /AUTOSAR
  module definition Os: variants post-build
    container OsAlarm [1..*]
      container OsAlarmSub [1..*]
