AUTOSAR XML (schema 4-0-3)
package /p
  module config configuration: definition=Os, implementation-config-variant=VARIANT-POST-BUILD
    container1 (OsAlarm): Boolean=true
package /AUTOSAR
  module definition Os: variants post-build
    container OsAlarm
      boolean Boolean [1..*]
