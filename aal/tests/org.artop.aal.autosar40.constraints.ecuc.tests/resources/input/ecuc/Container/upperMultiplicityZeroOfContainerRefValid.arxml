AUTOSAR XML (schema 4-0-3)
package /ARRoot
  module definition EcucModuleDef
    container TestContainer [1..0]
      choice reference TestRef [1..5]
  module config EcucModuleConfigurationValues: definition=EcucModuleDef
    TestContainer
