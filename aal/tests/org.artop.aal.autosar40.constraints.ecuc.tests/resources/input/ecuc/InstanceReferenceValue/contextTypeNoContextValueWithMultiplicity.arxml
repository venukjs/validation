AUTOSAR XML (schema 4-0-3)
package /OS_Package1
  module definition test
    container DbgAddInfoVfbSignal
      instance reference DbgDataElementInstanceRef: destination-context=SW-COMPONENT-PROTOTYPE* P-PORT-PROTOTYPE ROOT-SW-COMPOSITION-PROTOTYPE*, destination-type=VARIABLE-DATA-PROTOTYPE
  ecuc-module-configuration-values definition=test:
    DbgAddInfoVfbSignal: DbgDataElementInstanceRef=ComponentPrototype1.PPortProtoype3.DataElementPrototype1
package /OS_Package2
  application sw component type ForeignTarget1
  application sw component type ForeignTarget2
  composition sw component type CompositionType
    provide port PPortProtoype1: provided-interface=SenderReceiverInterface1
    component ComponentPrototype1: type=CompositionType1
    component ComponentPrototype2: type=CompositionType1
  composition sw component type CompositionType1
    provide port PPortProtoype2: provided-interface=SenderReceiverInterface2
    component ComponentPrototype1: type=CompositionType2
    component ComponentPrototype2: type=CompositionType2
  composition sw component type CompositionType2
    provide port PPortProtoype3: provided-interface=SenderReceiverInterface2
    component ComponentPrototype1
    component ComponentPrototype2
  system System1
    root-software-compositions:
      root sw composition prototype SoftwareComposition1: software-composition=CompositionType2
  system System2
    root-software-compositions:
      root sw composition prototype SoftwareComposition2: software-composition=CompositionType1
  sender receiver interface SenderReceiverInterface1
    data DataElementPrototype1
  sender receiver interface SenderReceiverInterface
  sender receiver interface SenderReceiverInterface2
    data DataElementPrototype2
