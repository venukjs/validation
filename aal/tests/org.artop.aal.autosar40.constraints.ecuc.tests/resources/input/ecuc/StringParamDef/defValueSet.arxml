AUTOSAR XML (schema 4-0-2)
package /TEST
  module definition ModuleDef
    container Strings
      string String1: default-value=default
