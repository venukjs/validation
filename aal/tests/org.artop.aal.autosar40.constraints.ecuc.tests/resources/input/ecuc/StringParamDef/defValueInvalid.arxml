AUTOSAR XML (schema 4-0-2)
package /TEST
  module definition ModuleDef
    container Strings
      string String0 [0..1]: default-value=9//
