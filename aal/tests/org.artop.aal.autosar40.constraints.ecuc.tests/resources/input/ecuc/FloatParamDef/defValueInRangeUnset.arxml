AUTOSAR XML (schema 4-0-3)
package /ARRoot
  module definition ModuleDef
    container Container
      float FloatDef: default-value=5.0
