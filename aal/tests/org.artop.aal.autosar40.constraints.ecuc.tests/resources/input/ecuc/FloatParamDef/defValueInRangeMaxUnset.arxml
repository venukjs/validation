AUTOSAR XML (schema 4-0-3)
package /ARRoot
  module definition ModuleDef
    container Container
      float FloatDef: 5.0.., default-value=10.0
