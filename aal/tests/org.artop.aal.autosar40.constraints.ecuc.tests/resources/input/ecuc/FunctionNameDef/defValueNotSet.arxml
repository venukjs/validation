AUTOSAR XML (schema 4-0-2)
package /TEST
  module definition ModuleDef
    container Functions
      function name FunctionN [1..*]
