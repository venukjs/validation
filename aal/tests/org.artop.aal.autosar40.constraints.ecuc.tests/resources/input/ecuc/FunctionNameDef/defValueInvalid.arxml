AUTOSAR XML (schema 4-0-2)
package /TEST
  module definition ModuleDef
    container Functions
      function name Function0 [0..1]: default-value=/'hgl;
