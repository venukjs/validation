AUTOSAR XML (schema 4.0)
package /p
  module config configuration: definition=Os
    container (OsAlarm)
package /AUTOSAR
  module definition Os: variants post-build
    container OsAlarm
      boolean BooleanParameter: default-value=false
