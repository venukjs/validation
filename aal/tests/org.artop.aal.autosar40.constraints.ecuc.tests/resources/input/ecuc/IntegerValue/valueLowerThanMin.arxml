AUTOSAR XML (schema 4.0)
package /p
  module config configuration: definition=Os, implementation-config-variant=VARIANT-PRE-COMPILE
    container (OsAlarm): OsAppErrorHookkk=665
package /AUTOSAR
  module definition Os
    container OsAlarm
      integer OsAppErrorHookkk: 666..667
