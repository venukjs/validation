AUTOSAR XML (schema 4-0-2)
package /TEST
  module definition ModuleDef
    container Linkers
      linker symbol Linker1: default-value=default
