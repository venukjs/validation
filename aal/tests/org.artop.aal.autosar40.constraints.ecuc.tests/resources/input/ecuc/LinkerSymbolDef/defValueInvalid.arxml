AUTOSAR XML (schema 4-0-2)
package /TEST
  module definition ModuleDef
    container Linkers
      linker symbol Linker0 [0..1]: default-value=gkfg///
