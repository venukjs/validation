AUTOSAR XML (schema 4-0-2)
package /TEST
  module definition ModuleDef
    container Linkers
      linker symbol LinkerN [1..*]
