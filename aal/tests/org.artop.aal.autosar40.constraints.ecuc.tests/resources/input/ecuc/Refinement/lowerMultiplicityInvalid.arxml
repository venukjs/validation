AUTOSAR XML (schema 4-0-3)
package /TS_T2D13M4I0R57
  ecuc definition collection myEcuParameterDefinition: module=TS_T2D13M4I0R57/Os
  module definition Os: refined-module-def=EcucDefs/Os, variants pre-compile  # Configuration of the Os (Operating System) module.
    container OsAlarm [0..*]  # An OsAlarm may be used to asynchronously inform or activate a specific task. It is possible to start alarms automatically at system start-up depending on the application mode.
      choice container OsAlarmAction  # This container defines which type of notification is used when the alarm expires.
        container OsAlarmActivateTask [0..1]  # This container specifies the parameters to activate a task.
        container OsAlarmCallback [0..1]  # This container specifies the parameters to call a callback OS alarm action.
          function name OsAlarmCallbackName: set at pre-compile  # Name of the function that is called when this alarm callback is triggered.
        container OsAlarmIncrementCounter [0..1]  # This container specifies the parameters to increment a counter.
        container OsAlarmSetEvent [0..1]  # This container specifies the parameters to set an event
      container OsAlarmAutostart [0..0]  # If present this container defines if an alarm is started automatically at system start-up depending on the application mode.
        integer OsAlarmAlarmTime: 0..9223372036854775807, set at pre-compile  # The relative or absolute tick value when the alarm expires for the first time. Note that for an alarm which is RELATIVE the value must be at bigger than 0.
        enumeration OsAlarmAutostartType: {ABSOLUTE, RELATIVE}, set at pre-compile  # This specifies the type of autostart for the alarm..
        integer OsAlarmCycleTime: 0..9223372036854775807, set at pre-compile  # Cycle time of a cyclic alarm in ticks. If the value is 0 than the alarm is not cyclic.
    container OsOS  # OS is the object used to define OSEK OS properties for an OSEK application.
      integer OsNumberOfCores [0..1]: 1..65535, set at pre-compile  # Maximum number of cores that are controlled by the OS.
      enumeration OsScalabilityClass [0..1]: {SC1, SC2, SC3, SC4}, set at pre-compile  # A scalability class for each System Object "OS" has to be selected. In order to customize the operating system to the needs of the user and to take full advantage of the processor features the operating system can be scaled according to the scalability classes.
      boolean OsStackMonitoring: set at pre-compile  # Select stack monitoring of Tasks/Category 2 ISRs
      enumeration OsStatus: {EXTENDED, STANDARD}, set at pre-compile  # The Status attribute specifies whether a system with standard or extended status has to be used. Automatic assigment is not supported for this attribute.
      boolean OsUseGetServiceId: set at pre-compile  # As defined by OSEK
      boolean OsUseParameterAccess: set at pre-compile  # As defined by OSEK
      boolean OsUseResScheduler: set at pre-compile, default-value=true  # The OsUseResScheduler attribute defines whether the resource RES_SCHEDULER is used within the application.
      enumeration OsCC [0..1]: {BCC1, ECC1, AUTO}, set at pre-compile, origin=FREESCALE, default-value=AUTO  # Freescale vendor specific: Defines the conformance class of OS (/OS/CC)
      integer OsCommonStackSize [0..1]: 128..4294967295, set at pre-compile, origin=FREESCALE  # Freescale vendor specific: Specifies the common stack size for basic tasks in bytes (/OS/CommonStackSize)
      integer OsDebugLevel [0..1]: 0..4, set at pre-compile, origin=FREESCALE, default-value=0  # Freescale vendor specific: Specifies the ORTI support in OS (/OS/DEBUG_LEVEL)
      boolean OsIsrHooks [0..1]: set at pre-compile, origin=FREESCALE, default-value=false  # Freescale vendor specific: Defines whether or not IsrHook is called before and after ISR (/OS/IsrHooks)
      integer OsIsrStackSize [0..1]: 64..4294967295, set at pre-compile, origin=FREESCALE  # Freescale vendor specific: Specifies the ISR stack size in bytes (/OS/IsrStackSize)
      integer OsPattern [0..1]: 0..4294967295, set at pre-compile, origin=FREESCALE, default-value=1431655765  # Freescale vendor specific: Specifies a 8-bit pattern to fill stack; Freescale AUTOSAR OS specific attribute (/OS/STACKMONITORING/TRUE/Pattern)
      enumeration OsPatternSize [0..1]: {ONE, TWO, FOUR}, set at pre-compile, origin=FREESCALE, default-value=ONE  # Freescale vendor specific: PatternSize defines the size of area to be checked, in bytes for OS/S12X(E) and 32 in bit words for OS/MPC. Freescale AUTOSAR OS specific attribute (/OS/STACKMONITORING/TRUE/PatternSize)
      container OsHooks  # Container to structure all hooks belonging to the OS
        boolean OsErrorHook: set at pre-compile  # Error hook as defined by OSEK
        boolean OsPostTaskHook: set at pre-compile  # Post-task hook as defined by OSEK
        boolean OsPreTaskHook: set at pre-compile  # Pre-task hook as defined by OSEK
        boolean OsProtectionHook [0..1]: set at pre-compile  # Switch to enable/disable the call to the (user supplied) protection hook.
        boolean OsShutdownHook: set at pre-compile  # Shutdown hook as defined by OSEK
        boolean OsStartupHook: set at pre-compile  # Startup hook as defined by OSEK
      choice container OsTargetMCU  # Freescale vendor specific: Specifies MCU platform (/OS/TargetMCU)
        container MPC5607B [0..1]  # Freescale vendor specific: (/OS/TargetMCU/MPC5607B)
          integer OsClockDivider [0..1]: 1..4294967295, set at pre-compile, origin=FREESCALE, default-value=1  # Freescale vendor specific: Specifies hardware independent clock frequency divider for calculating input timer frequency (/OS/TargetMCU/MPC5607B/ClockDivider)
          integer OsClockFrequency [0..1]: 1000..100000, set at pre-compile, origin=FREESCALE, default-value=8000  # Freescale vendor specific: Specifies MCU frequency source in kHz for calculating prescaler value and timer modulo value (/OS/TargetMCU/MPC5607B/ClockFrequency)
          integer OsClockMultiplier [0..1]: 1..4294967295, set at pre-compile, origin=FREESCALE, default-value=1  # Freescale vendor specific: Specifies hardware independent clock frequency multiplier for calculating input timer frequency (/OS/TargetMCU/MPC5607B/ClockMultiplier)
          choice container OsExternalROM [0..1]  # Freescale vendor specific: (/OS/TargetMCU/MPC5607B/ExternalROM)
            container FALSE [0..1]  # Freescale vendor specific: (/OS/TargetMCU/MPC5607B/ExternalROM/FALSE)
            container TRUE [0..1]  # Freescale vendor specific: (/OS/TargetMCU/MPC5607B/ExternalROM/TRUE)
              integer Address: 0..4294967295, set at pre-compile, origin=FREESCALE  # Freescale vendor specific: Section address (/OS/TargetMCU/MPC5607B/ExternalROM/TRUE/Address)
              integer Size: 0..4294967295, set at pre-compile, origin=FREESCALE  # Freescale vendor specific: Section size (/OS/TargetMCU/MPC5607B/ExternalROM/TRUE/Size)
          choice container OsInternalRAM [0..1]  # Freescale vendor specific: (/OS/TargetMCU/MPC5607B/InternalRAM)
            container FALSE [0..1]  # Freescale vendor specific: (/OS/TargetMCU/MPC5607B/InternalRAM/FALSE)
            container TRUE [0..1]  # Freescale vendor specific: (/OS/TargetMCU/MPC5607B/InternalRAM/TRUE)
              integer Address [0..1]: 0..4294967295, set at pre-compile, origin=FREESCALE, default-value=1073741824  # Freescale vendor specific: Section address (/OS/TargetMCU/MPC5607B/InternalRAM/TRUE/Address)
              integer Size [0..1]: 0..4294967295, set at pre-compile, origin=FREESCALE, default-value=98304  # Freescale vendor specific: Section size (/OS/TargetMCU/MPC5607B/InternalRAM/TRUE/Size)
          choice container OsInternalROM [0..1]  # Freescale vendor specific: (/OS/TargetMCU/MPC5607B/InternalROM)
            container FALSE [0..1]  # Freescale vendor specific: (/OS/TargetMCU/MPC5607B/InternalROM/FALSE)
            container TRUE [0..1]  # Freescale vendor specific: (/OS/TargetMCU/MPC5607B/InternalROM/TRUE)
              integer Address [0..1]: 0..4294967295, set at pre-compile, origin=FREESCALE, default-value=0  # Freescale vendor specific: Section address (/OS/TargetMCU/MPC5607B/InternalROM/TRUE/Address)
              integer Size [0..1]: 0..4294967295, set at pre-compile, origin=FREESCALE, default-value=1572864  # Freescale vendor specific: Section size (/OS/TargetMCU/MPC5607B/InternalROM/TRUE/Size)
          choice container OsTPTimer [0..1]  # Freescale vendor specific: Specifies whether Timing Protection shall be initialized during OS startup (/OS/TargetMCU/MPC5607B/TPTimer)
            container FALSE [0..1]  # Freescale vendor specific: (/OS/TargetMCU/MPC5607B/TPTimer/FALSE)
            container TRUE [0..1]  # Freescale vendor specific: (/OS/TargetMCU/MPC5607B/TPTimer/TRUE)
              integer OsPeriod [0..1]: 0..4294967295, set at pre-compile, origin=FREESCALE  # Freescale vendor specific: Specifies period of a tick of the Timing Protection counter (in nanoseconds) (/OS/TargetMCU/MPC5607B/TPTimer/TRUE/Period)
              choice container OsTimerHardware [0..1]  # Freescale vendor specific: Specifies hardware interrupt source for the counter (/OS/TargetMCU/MPC5607B/TPTimer/TRUE/TimerHardware)
                container STM [0..1]  # Freescale vendor specific: (/OS/TargetMCU/MPC5607B/TPTimer/TRUE/TimerHardware/STM)
                  boolean OsFreeze [0..1]: set at pre-compile, origin=FREESCALE, default-value=false  # Freescale vendor specific: Specifies timer freeze bit value (/OS/TargetMCU/MPC5607B/TPTimer/TRUE/TimerHardware/STM/Freeze)
                  choice container OsPrescaler [0..1]  # Freescale vendor specific: Specifies either USER or OS prescaler shall be initialized during OS startup (/OS/TargetMCU/MPC5607B/TPTimer/TRUE/TimerHardware/STM/Prescaler)
                    container OS [0..1]  # Freescale vendor specific: (/OS/TargetMCU/MPC5607B/TPTimer/TRUE/TimerHardware/STM/Prescaler/OS)
                      integer OsValue [0..1]: 0..255, set at pre-compile, origin=FREESCALE  # Freescale vendor specific: Specifies OS initial prescaler value (/OS/TargetMCU/MPC5607B/TPTimer/TRUE/TimerHardware/STM/Prescaler/OS/Value)
package /AUTOSAR/EcucDefs
  module definition Os [0..1]: variants pre-compile  # Configuration of the Os (Operating System) module.
    container OsAlarm [0..*]  # An OsAlarm may be used to asynchronously inform or activate a specific task. It is possible to start alarms automatically at system start-up depending on the application mode.
      choice container OsAlarmAction  # This container defines which type of notification is used when the alarm expires.
        container OsAlarmActivateTask [0..1]  # This container specifies the parameters to activate a task.
        container OsAlarmCallback [0..1]  # This container specifies the parameters to call a callback OS alarm action.
          function name OsAlarmCallbackName: set at pre-compile  # Name of the function that is called when this alarm callback is triggered.
        container OsAlarmIncrementCounter [0..1]  # This container specifies the parameters to increment a counter.
        container OsAlarmSetEvent [0..1]  # This container specifies the parameters to set an event
      container OsAlarmAutostart  # If present this container defines if an alarm is started automatically at system start-up depending on the application mode.
        integer OsAlarmAlarmTime: 0..18446744073709551615, set at pre-compile  # The relative or absolute tick value when the alarm expires for the first time. Note that for an alarm which is RELATIVE the value must be at bigger than 0.
        enumeration OsAlarmAutostartType: {ABSOLUTE, RELATIVE}, set at pre-compile  # This specifies the type of autostart for the alarm..
        integer OsAlarmCycleTime: 0..18446744073709551615, set at pre-compile  # Cycle time of a cyclic alarm in ticks. If the value is 0 than the alarm is not cyclic.
    container OsOS  # OS is the object used to define OSEK OS properties for an OSEK application. | Per CPU exactly one OS object has to be defined.
      integer OsNumberOfCores [0..1]: 1..65535, set at pre-compile  # Maximum number of cores that are controlled by the OS. | The OS uses the value internally. It depends on the ECU HW.
      enumeration OsScalabilityClass [0..1]: {SC1, SC2, SC3, SC4}, set at pre-compile  # A scalability class for each System Object "OS" has to be selected. In order to customize the operating system to the needs of the user and to take full advantage of the processor features the operating system can be scaled according to the scalability classes. | If the scalability class is omitted this translates to the OIL AUTO mechanism.
      boolean OsStackMonitoring: set at pre-compile  # Select stack monitoring of Tasks/Category 2 ISRs | true: Stacks are monitored false: Stacks are not monitored
      enumeration OsStatus: {EXTENDED, STANDARD}, set at pre-compile  # The Status attribute specifies whether a system with standard or extended status has to be used. Automatic assigment is not supported for this attribute.
      boolean OsUseGetServiceId: set at pre-compile  # As defined by OSEK
      boolean OsUseParameterAccess: set at pre-compile  # As defined by OSEK
      boolean OsUseResScheduler: set at pre-compile, default-value=true  # The OsUseResScheduler attribute defines whether the resource RES_SCHEDULER is used within the application.
      container OsHooks  # Container to structure all hooks belonging to the OS
        boolean OsErrorHook: set at pre-compile  # Error hook as defined by OSEK | true: Hook is called false: Hook is not called
        boolean OsPostTaskHook: set at pre-compile  # Post-task hook as defined by OSEK | true: Hook is called false: Hook is not called
        boolean OsPreTaskHook: set at pre-compile  # Pre-task hook as defined by OSEK | true: Hook is called false: Hook is not called
        boolean OsProtectionHook [0..1]: set at pre-compile  # Switch to enable/disable the call to the (user supplied) protection hook. | true: Protection hook is called on protection error false: Protection hook is not called
        boolean OsShutdownHook: set at pre-compile  # Shutdown hook as defined by OSEK | true: Hook is called false: Hook is not called
        boolean OsStartupHook: set at pre-compile  # Startup hook as defined by OSEK | true: Hook is called false: Hook is not called
