AUTOSAR XML (schema 4.0)
package /p
  module config configuration: definition=Os, implementation-config-variant=VARIANT-PRE-COMPILE
    container (OsAlarm): Valid=ttt
package /AUTOSAR
  module definition Os
    container OsAlarm
      linker symbol Valid
