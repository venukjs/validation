AUTOSAR XML (schema 4-0-3)
package /ARRoot
  module definition ModuleDef
    container Container
      integer IntegerDef: 5.., default-value=10
