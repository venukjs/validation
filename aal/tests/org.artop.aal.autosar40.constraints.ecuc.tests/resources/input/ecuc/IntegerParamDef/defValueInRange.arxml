AUTOSAR XML (schema 4-0-3)
package /ARRoot
  module definition ModuleDef
    container Container
      integer IntegerDef: 10..15, default-value=12
