AUTOSAR XML (schema 3.1.1)
package /p
  module config configuration: definition=Os, implementation-config-variant=VARIANT-POST-BUILD
    container (OsAlarm)
package /AUTOSAR
  module definition Os
    container OsAlarm
      boolean BooleanParameter: default-value=false
