AUTOSAR XML (schema 3.1.4)
package /ARRoot
  client server interface ClientServerInterface
  sender receiver interface ModeSwitchInterface
  sender receiver interface MySRInterface
    data data
  client server interface DidServices_One
  sender receiver interface MSInterface
