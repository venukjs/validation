AUTOSAR XML (schema 2.1.5)
package /ARRoot
  client server interface ClientServerInterface
  sender receiver interface ModeSwitchInterface
  sender receiver interface MySRInterface
    data data
  client server interface DidServices_One
  sender receiver interface MSInterface
