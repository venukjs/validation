AUTOSAR XML
package /ARRoot
  client server interface ClientServerInterface
  sender receiver interface ModeSwitchInterface
  sender receiver interface MySRInterface
    data data
  client server interface DidServices_One
  sender receiver interface MSInterface
