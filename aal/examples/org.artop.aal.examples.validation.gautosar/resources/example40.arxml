AUTOSAR XML (schema 4.0)
package /ARRoot
  client server interface ClientServerInterface
  client server interface DidServices_One
  mode switch interface ModeSwitchInterface
  mode switch interface MSInterface
  sender receiver interface MySRInterface
    data data
