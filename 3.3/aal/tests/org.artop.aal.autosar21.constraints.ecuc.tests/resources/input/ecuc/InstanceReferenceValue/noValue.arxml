AUTOSAR XML (schema 2.1.2)
package /OS_Package1
  composition type OS_Composition
    component OS_ComponentPrototype: type=OS_ApplicationSoftwareComponentType
package /OS_Package2
  atomic software component type OS_ApplicationSoftwareComponentType
    provide port OS_PPortPrototype
package /OS_Package3
  module config OS_ModuleConfiguration: definition=OS_ModuleDefinition, implementation-config-variant=VARIANT-PRE-COMPILE
    OS_Container (OS_ParamConfContainerDef): OS_InstanceReferenceParamDef=(unset)
package /OS_Package4
  module definition OS_ModuleDefinition
    container OS_ParamConfContainerDef
      instance reference OS_InstanceReferenceParamDef: destination-context=ComponentPrototype, destination-type=PPortPrototype
