AUTOSAR XML (schema 2-1-5)
package /TEST
  module definition ModuleDef
    container Strings
      string String0 [0..1]: default-value=default
