AUTOSAR XML (schema 2-1-5)
package /TEST
  module definition ModuleDef
    container Functions: parameters=function-name-def=default-value=default
