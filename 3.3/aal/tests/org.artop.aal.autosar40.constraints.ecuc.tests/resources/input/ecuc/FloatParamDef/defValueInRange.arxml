AUTOSAR XML (schema 4-0-3)
package /ARRoot
  module definition ModuleDef
    container Container
      float FloatDef: 10.0..15.0, default-value=12.0
