AUTOSAR XML (schema 4-0-3)
package /AUTOSAR/EcucDefs
  module definition Vendor_Module
    container EcucParamConfContainerDef
      float EcucFloatParamDef: -INF..INF, default-value=100.0
  module config myVendor_Module: definition=Vendor_Module
    EcucParamConfContainerDef: EcucFloatParamDef=12.0
