AUTOSAR XML (schema 4.0)
package /p
  module config configuration: definition=Os, implementation-config-variant=VARIANT-PRE-COMPILE
    container (OsAlarm): OsAppErrorHookFloat=7
package /AUTOSAR
  module definition Os
    container OsAlarm
      float OsAppErrorHookFloat: 0..667
