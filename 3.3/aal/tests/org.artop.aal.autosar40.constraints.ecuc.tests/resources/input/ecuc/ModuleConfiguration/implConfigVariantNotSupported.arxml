AUTOSAR XML (schema 4.0)
package /p
  module config configuration: definition=Os, implementation-config-variant=VARIANT-POST-BUILD
    container (OsAlarm)
package /AUTOSAR
  module definition Os: variants link-time/pre-compile
    container OsAlarm
      boolean BooleanParameter: default-value=false
