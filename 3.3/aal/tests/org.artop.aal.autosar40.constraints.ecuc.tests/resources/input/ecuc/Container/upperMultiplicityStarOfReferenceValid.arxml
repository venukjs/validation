AUTOSAR XML (schema 4-0-3)
package /p
  module config configuration: definition=Os, implementation-config-variant=VARIANT-POST-BUILD
    container1 (Container1): Ref=container2
    container2 (Container2)
package /AUTOSAR
  module definition Os: variants post-build
    container Container1
      reference Ref [1..*]: destination=Container2
    container Container2
