AUTOSAR XML (schema 3-1-5)
package /ARRoot
  module definition ModuleDef
    container Container
      integer IntegerDef: 5.., default-value=10
