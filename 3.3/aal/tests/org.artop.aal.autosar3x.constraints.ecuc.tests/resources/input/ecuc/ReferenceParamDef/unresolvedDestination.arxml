AUTOSAR XML (schema 3.1.1)
package /AUTOSAR
  module definition Os
    container Alternative1
    container Alternative2
    container ParamConfContainerDef1
      reference OsAppScheduleTableRef: destination=unresolved
